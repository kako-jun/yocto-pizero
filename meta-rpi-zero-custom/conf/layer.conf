## meta-rpi-zero-custom/conf/layer.conf
```bitbake
# Custom layer for Raspberry Pi Zero

BBPATH .= ":${LAYERDIR}"

BBFILES += "${LAYERDIR}/recipes-*/*/*.bb \
            ${LAYERDIR}/recipes-*/*/*.bbappend"

BBFILE_COLLECTIONS += "rpi-zero-custom"
BBFILE_PATTERN_rpi-zero-custom = "^${LAYERDIR}/"
BBFILE_PRIORITY_rpi-zero-custom = "10"

LAYERDEPENDS_rpi-zero-custom = "core raspberrypi"
LAYERSERIES_COMPAT_rpi-zero-custom = "kirkstone"
```
